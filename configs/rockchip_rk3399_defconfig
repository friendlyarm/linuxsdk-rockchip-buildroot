## configs/rockchip_rk3399_defconfig
```kconfig
#include "base/base.config"
#include "chips/rk3399_aarch64.config"
#include "font/chinese.config"
#include "fs/exfat.config"
#include "fs/ntfs.config"
#include "fs/vfat.config"
#include "gpu/gpu.config"
#include "multimedia/audio.config"
#include "multimedia/camera.config"
#include "multimedia/gst/audio.config"
#include "multimedia/gst/camera.config"
#include "multimedia/gst/rtsp.config"
#include "multimedia/gst/video.config"
#include "multimedia/mpp.config"
#include "benchmark.config"
#include "chromium.config"
#include "debug.config"
#include "powermanager.config"
#include "test.config"
#include "weston.config"
BR2_PACKAGE_GST1_LIBAV=y
BR2_TARGET_GENERIC_GETTY_PORT="ttyFIQ0"
BR2_TARGET_GENERIC_GETTY_BAUDRATE_1500000=y
BR2_ROOTFS_OVERLAY="board/rockchip/rk3399/fs-overlay-64/"
BR2_TARGET_GENERIC_HOSTNAME="rk3399"
BR2_TARGET_GENERIC_ISSUE="Welcome to RK3399 Buildroot"
BR2_PACKAGE_RKWIFIBT_AP6356=y
BR2_PACKAGE_RKWIFIBT_BTUART="ttyS0"
BR2_TARGET_ROOTFS_TAR_XZ=y
```
